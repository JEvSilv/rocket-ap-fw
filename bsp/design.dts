/include/ "core.dts"
/ {
	chosen {
		metal,entry = <&L11 1 4194304>;
		metal,boothart = <&L4>;
		stdout-path = "/soc/serial@20000000:115200";
		metal,itim = <&L13 0 0>;
		metal,ram = <&L12 0 0>;
	};
};
